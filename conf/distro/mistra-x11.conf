## conf/distro/mistra-x11.conf
```bitbake
# Mistra Distro for X11 without wayland.

require conf/distro/include/mistra-base.inc

DISTRO = "mistra-x11"
DISTRO_NAME = "Mistra X11"

# Remove conflicting backends.
DISTRO_FEATURES:remove = "wayland "

# These are X11 specific
DISTRO_FEATURES:append = " x11"
```

## conf/layer.conf
```bitbake
# We have a conf and classes directory, add to BBPATH
BBPATH .= ":${LAYERDIR}"

# We have recipes-* directories, add to BBFILES
BBFILES += " \
	${LAYERDIR}/recipes-*/*/*.bb \
	${LAYERDIR}/recipes-*/*/*.bbappend \
	"

BBFILE_COLLECTIONS += "meta-vexpress"
BBFILE_PATTERN_meta-vexpress = "^${LAYERDIR}/"
LAYERDEPENDS_meta-vexpress = " \
	core \
"

LAYERSERIES_COMPAT_meta-vexpress = "kirkstone"
```

## conf/machine/vexpress-qemu.conf
```bitbake
#@TYPE: Machine
#@NAME: vexpress-qemu

#@DESCRIPTION: Machine configuration for QEMU running vexpress with system on MMC device


MACHINE_EXTRA_RRECOMMENDS = " kernel-modules kernel-devicetree"

IMAGE_FSTYPES += "tar.bz2 wic wic.bmap"
WKS_FILE ?= "vexpress-yocto.wks"
do_image_wic[depends] += "mtools-native:do_populate_sysroot dosfstools-native:do_populate_sysroot u-boot-vexpress:do_deploy"

IMAGE_BOOT_FILES = " \
    u-boot.${UBOOT_SUFFIX} \
    zImage \
    vexpress-v2p-ca9.dtb \
    boot.scr \
"

IMAGE_INSTALL:append = " kernel-image kernel-devicetree"

require conf/machine/include/arm/armv7a/tune-cortexa9.inc

PREFERRED_PROVIDER_virtual/kernel ?= "linux-vexpress"

SERIAL_CONSOLE = "115200 ttyAMA0"

KERNEL_IMAGETYPE = "zImage"
KERNEL_DEVICETREE = "vexpress-v2p-ca9.dtb"
KERNEL_EXTRA_ARGS += "LOADADDR=${UBOOT_ENTRYPOINT}"

PREFERRED_PROVIDER_u-boot ??= "u-boot-vexpress"
PREFERRED_PROVIDER_virtual/bootloader ??= "u-boot-vexpress"

UBOOT_SUFFIX = "bin"
UBOOT_MACHINE = "vexpress_ca9x4_config"
UBOOT_ENTRYPOINT = "0x60800000"
UBOOT_LOADADDRESS = "0x60800000"

UBOOT_ELF ?= "u-boot"


# Needed to skip particular QA checks that don't apply to U-boot's binary.
INSANE_SKIP:u-boot-vexpress += "ldflags textrel"
```
